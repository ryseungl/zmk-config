## boards/shields/iris_custom/Kconfig.defconfig
```kconfig
if SHIELD_IRIS_CUSTOM_DONGLE

config ZMK_KEYBOARD_NAME
    default "HITE K56"

config ZMK_SPLIT_ROLE_CENTRAL
    default y

config ZMK_SPLIT_BLE_CENTRAL_PERIPHERALS
    default 2

endif

if SHIELD_IRIS_CUSTOM_LEFT || SHIELD_IRIS_CUSTOM_RIGHT || SHIELD_IRIS_CUSTOM_DONGLE

config ZMK_SPLIT
    default y

endif
```
