&kscan0 {
    row-gpios
        = <&gpio0 17 (GPIO_ACTIVE_HIGH | GPIO_PULL_DOWN)>  /* ROW0 */
        , <&gpio0 20 (GPIO_ACTIVE_HIGH | GPIO_PULL_DOWN)>  /* ROW1 */
        , <&gpio0 22 (GPIO_ACTIVE_HIGH | GPIO_PULL_DOWN)>  /* ROW2 */
        , <&gpio0 24 (GPIO_ACTIVE_HIGH | GPIO_PULL_DOWN)>  /* ROW3 */
        , <&gpio1  0 (GPIO_ACTIVE_HIGH | GPIO_PULL_DOWN)>  /* ROW4 */
        ;

    col-gpios
        = <&gpio0 31 GPIO_ACTIVE_HIGH>  /* COL0 */
        , <&gpio1  4 GPIO_ACTIVE_HIGH>  /* COL1 */
        , <&gpio1  6 GPIO_ACTIVE_HIGH>  /* COL2 */
        , <&gpio0  9 GPIO_ACTIVE_HIGH>  /* COL3 */
        , <&gpio0 10 GPIO_ACTIVE_HIGH>  /* COL4 */
        , <&gpio1 11 GPIO_ACTIVE_HIGH>  /* COL5 */
        ;
};
